## dts/bindings/behaviors/joe,indicator-layer.yaml
```yaml
description: Layer switching that distinguishes toggled layers from held layers
compatible: "joe,indicator-layer"
include: one_param.yaml
properties:
  mode:
    type: string
    enum: ["toggle", "momentary", "to"]
    required: true
```

## dts/bindings/behaviors/joe,led-calibration.yaml
```yaml
description: Select a half and an absolute LED index for calibration
compatible: "joe,led-calibration"
include: two_param.yaml
```

## dts/bindings/behaviors/joe,led-status.yaml
```yaml
description: Battery display and layer-indicator controls
compatible: "joe,led-status"
include: two_param.yaml
```

## dts/bindings/led_strip/joe,calibration-strip.yaml
```yaml
description: Pass-through RGB strip with a temporary single-LED calibration override
compatible: "joe,calibration-strip"
include: base.yaml
properties:
  strip:
    type: phandle
    required: true
  chain-length:
    type: int
    required: true
```
